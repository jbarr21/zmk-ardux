## config/west.yml
```yaml
manifest:
  remotes:
    - name: zmkfirmware
      url-base: https://github.com/zmkfirmware
    - name: zmk-ardux
      url-base: https://github.com/arduxio
    - name: urob
      url-base: https://github.com/urob
    - name: jbarr21
      url-base: https://github.com/jbarr21
  projects:
    - name: zmk
      remote: zmkfirmware
      revision: ae8299edb3d638f1332475b1da0fdf40afa43fe4
      import: app/west.yml
  self:
    path: config
```
